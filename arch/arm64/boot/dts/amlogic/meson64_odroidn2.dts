// SPDX-License-Identifier: (GPL-2.0+ OR MIT)
/*
 * Copyright (c) 2026 Hardkernel Co., Ltd.
 *
 */

#include "meson-g12b-odroid-n2.dts"
#include <dt-bindings/leds/common.h>

&{/} {
	leds {
		led-blue {
			/delete-property/ label;
			color = <LED_COLOR_ID_BLUE>;
			function = LED_FUNCTION_HEARTBEAT;
		};
	};
};
