/*
 * arch/arm64/boot/dts/amlogic/meson64_odroidn2_drm.dts
 *
 * Copyright (C) 2019 Hardkernel Co,. Ltd. All rights reserved.
 *
 * This program is free software; you can redistribute it and/or modify
 * it under the terms of the GNU General Public License as published by
 * the Free Software Foundation; either version 2 of the License, or
 * (at your option) any later version.
 *
 * This program is distributed in the hope that it will be useful, but WITHOUT
 * ANY WARRANTY; without even the implied warranty of MERCHANTABILITY or
 * FITNESS FOR A PARTICULAR PURPOSE.  See the GNU General Public License for
 * more details.
 *
 */

/dts-v1/;

#include "meson64_odroidn2.dts"
#include "mesong12a_drm.dtsi"

&meson_fb {
	status = "disabled";
};

&drm_vpu {
	status = "okay";
	compatible = "amlogic,meson-g12b-vpu";
	logo_addr = "0x7f800000";
};

&drm_amhdmitx {
	status = "okay";
	hdcp = "disabled";
};

&drm_lcd {
	status = "disabled";
};
