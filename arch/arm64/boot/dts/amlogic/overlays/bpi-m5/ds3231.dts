/dts-v1/;
/plugin/;

/ {
	fragment@0 {
		// i2c2 aliased with i2c0.
		target = <&i2c2>;

		__overlay__ {
			status = "okay";

			#address-cells = <1>;
			#size-cells = <0>;

			ds3231: rtc@68 {
				status = "okay";
				compatible = "ds3231";
				reg = <0x68>;
			};
		};
	};
};
