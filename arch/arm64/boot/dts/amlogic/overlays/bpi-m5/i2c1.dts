/dts-v1/;
/plugin/;

/ {
	fragment@0 {
		// i2c3 aliased with i2c1.
		// This activates i2c3 but it will be named as i2c1 on the userspace.
		target = <&i2c3>;

		__overlay__ {
			status = "okay";
		};
	};
};
