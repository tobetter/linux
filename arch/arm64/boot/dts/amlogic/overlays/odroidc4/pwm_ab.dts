/dts-v1/;
/plugin/;

/ {
	fragment@0 {
		target = <&pwm_ab>;

		__overlay__ {
			status = "okay";
			pinctrl-names = "default", "gpio_periphs";
			pinctrl-0 = <&pwm_a_pins &pwm_b_x19_pins>;
			pinctrl-1 = <&pwmab_to_gpios>;
		};
	};
};
