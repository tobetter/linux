/dts-v1/;
/plugin/;

#include <dt-bindings/gpio/meson-g12a-gpio.h>
#include <dt-bindings/gpio/gpio.h>

/ {
	fragment@0 {
		target = <&pwm_f_x_pins>;

		__overlay__ {
			mux {
				groups = "GPIOX_7";
				function = "gpio_periphs";
				bias-disable;
				drive-strength-microamp = <4000>;
			};
		};
	};

	fragment@1 {
		target-path = "/";

		__overlay__ {
			onewire: onewire {
				compatible = "w1-gpio";
				status = "okay";
				pinctrl-names = "default";
				pinctrl-0 = <&pdm_din1_x_pins>;
				gpios = <&gpio GPIOX_7 GPIO_ACTIVE_HIGH>;
			};
		};
	};
};
