/dts-v1/;
/plugin/;

/ {
	fragment@0 {
		target = <&sd_emmc_a>;

		__overlay__ {
			status = "okay";

			sdio {
				caps = "MMC_CAP_4_BIT_DATA",
					 "MMC_CAP_MMC_HIGHSPEED",
					 "MMC_CAP_SD_HIGHSPEED",
					 "MMC_CAP_NONREMOVABLE",
					 "MMC_CAP_UHS_SDR12",
					 "MMC_CAP_UHS_SDR25",
					 "MMC_CAP_UHS_SDR50",
					 "MMC_CAP_UHS_SDR104",
					 "MMC_PM_KEEP_POWER";
			};
		};
	};
};
