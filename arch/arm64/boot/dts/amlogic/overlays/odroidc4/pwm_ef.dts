/dts-v1/;
/plugin/;

/ {
	fragment@0 {
		target = <&pwm_ef>;

		__overlay__ {
			status = "okay";
			pinctrl-names = "default", "gpio_periphs";
			pinctrl-0 = <&pwm_e_pins &pwm_f_x_pins>;
			pinctrl-1 = <&pwmef_to_gpios>;
		};
	};
};
