/dts-v1/;
/plugin/;

/ {
	fragment@0 {
		target = <&pwm_cd>;

		__overlay__ {
			status = "okay";
			pinctrl-names = "default", "gpio_periphs";
			pinctrl-0 = <&pwm_c_x5_pins &pwm_d_x3_pins>;
			pinctrl-1 = <&pwmcd_to_gpios>;
		};
	};
};
