/dts-v1/;
/plugin/;

#include <dt-bindings/gpio/meson-g12a-gpio.h>
#include <dt-bindings/gpio/gpio.h>

/ {
	fragment@0 {
		target = <&spicc0>;

		__overlay__ {
			status = "okay";

			cs-gpios = <&gpio GPIOX_10 GPIO_ACTIVE_LOW>;

			display: display@0 {
				#address-cells = <0x1>;
				#size-cells = <0x0>;

				status = "okay";

				compatible = "hardkernel,hktft32";
				reg = <0>;

				spi-max-frequency = <40000000>;
				rotation = <90>;
				reset-gpios = <&gpio GPIOX_4 GPIO_ACTIVE_HIGH>;
				dc-gpios = <&gpio GPIOX_7 GPIO_ACTIVE_HIGH>;
			};
		};
	};
};

