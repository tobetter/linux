/dts-v1/;
/plugin/;

#include <dt-bindings/gpio/meson-g12a-gpio.h>
#include <dt-bindings/gpio/gpio.h>

&spicc0 {
	status = "okay";
	cs-gpios = <&gpio GPIOX_10 GPIO_ACTIVE_LOW>;

	#address-cells = <1>;
	#size-cells = <0>;

	spidev: spidev@0 {
		status = "okay";
		compatible = "linux,spidev";
		reg = <0>;
		spi-max-frequency = <100000000>;
	};
};
