/dts-v1/;
/plugin/;

#include <dt-bindings/gpio/gpio.h>
#include <dt-bindings/gpio/meson-g12a-gpio.h>
#include <dt-bindings/interrupt-controller/irq.h>

/ {
        fragment@0 {
                target = <&i2c3>;

                __overlay__ {
                        status = "okay";

                        #address-cells = <1>;
                        #size-cells = <0>;

                        sx865x: sx865x@49 {
				status = "okay";
				compatible = "semtech,sx8650";
				reg = <0x49>;
				#clock-cells = <0>;

				interrupt-parent = <&gpio_intc>;
				/* GPIOH_5 */
				interrupts = <33 IRQ_TYPE_EDGE_FALLING>;
				reset-gpios = <&gpio GPIOH_7 GPIO_ACTIVE_LOW>;

				touchscreen-inverted-x;
				touchscreen-swapped-x-y;
                        };
                };
        };
};
