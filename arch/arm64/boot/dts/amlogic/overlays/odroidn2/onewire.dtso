/dts-v1/;
/plugin/;

#include <dt-bindings/gpio/meson-g12a-gpio.h>
#include <dt-bindings/gpio/gpio.h>

&{/} {
	onewire:onewire {
		compatible = "w1-gpio";
		gpios = <&gpio GPIOX_7 GPIO_ACTIVE_HIGH>;
		status = "okay";
	};
};
