/dts-v1/;
/plugin/;

#include <dt-bindings/gpio/meson-g12a-gpio.h>
#include <dt-bindings/gpio/gpio.h>

/ {
	fragment@0 {
		target = <&spicc0>;

		__overlay__ {
			status = "okay";

			cs-gpios = <&gpio GPIOX_10 GPIO_ACTIVE_LOW>;

			spidev: spidev@0 {
				spi-max-frequency = <100000000>;
			};
		};
	};
};
