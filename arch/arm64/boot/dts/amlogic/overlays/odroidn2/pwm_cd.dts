/dts-v1/;
/plugin/;

/ {
	fragment@0 {
		target = <&pwm_cd>;

		__overlay__ {
			status = "okay";

			pinctrl-names = "default";
			pinctrl-0 = <&pwm_c_x5_pins &pwm_d_x6_pins>;
			pinctrl-1 = <&pwmcd_to_gpios>;
		};
	};
};
