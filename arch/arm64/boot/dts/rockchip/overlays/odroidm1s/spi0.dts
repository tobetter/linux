/dts-v1/;
/plugin/;

/ {
	fragment@0 {
		target = <&spi1>;

		__overlay__ {
			status = "okay";

			spidev: spidev@0 {
				status = "okay";
				compatible = "odroid,spi-dev";
				reg = <0>;
				spi-max-frequency = <100000000>;
			};
		};
	};
};
