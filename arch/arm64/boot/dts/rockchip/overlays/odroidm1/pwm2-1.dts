/dts-v1/;
/plugin/;

#include "../../rk3568-pinctrl.dtsi"

/ {
	fragment@0 {
		// pwmchip1, pwm@fdd70020
		target = <&pwm2>;

		__overlay__ {
			status = "okay";

			pinctrl-0 = <&pwm2m1_pins>;
		};
	};
};
