/dts-v1/;
/plugin/;

#include "../../rk3568-pinctrl.dtsi"

/ {
	fragment@0 {
		// uart1 aliased with serial0.
		target = <&uart1>;

		__overlay__ {
			status = "okay";

			dma-names = "tx", "rx";
			pinctrl-names = "default";
			pinctrl-0 = <&uart1m1_xfer &uart1m1_ctsn &uart1m1_rtsn>;
		};
	};
};
