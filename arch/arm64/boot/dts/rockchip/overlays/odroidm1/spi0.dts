/dts-v1/;
/plugin/;

/ {
	fragment@0 {
		target = <&spi0>;

		__overlay__ {
			status = "okay";

			spidev: spidev@0 {
				status = "okay";
				compatible = "odroid,spi-dev";
				reg = <0>;
				/* spi default max clock 100Mhz */
				spi-max-frequency = <100000000>;
			};
		};
	};
};
