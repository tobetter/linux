/dts-v1/;
/plugin/;

/ {
	fragment@0 {
		target = <&i2c_1>;

		__overlay__ {
			status = "disabled";
		};
	};

	fragment@1 {
		target = <&hsi2c_5>;

		__overlay__ {
			status = "disabled";
		};
	};

	fragment@2 {
		target = <&spi_1>;

		__overlay__ {
			status = "okay";
		};
	};

	fragment@3 {
		target = <&hktft32>;

		__overlay__ {
			status = "okay";
		};
	};
};
