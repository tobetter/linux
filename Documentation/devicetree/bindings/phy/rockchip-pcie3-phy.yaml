## Documentation/devicetree/bindings/phy/rockchip-pcie3-phy.yaml
```yaml
# SPDX-License-Identifier: GPL-2.0
%YAML 1.2
---
$id: http://devicetree.org/schemas/phy/rockchip-pcie3-phy.yaml#
$schema: http://devicetree.org/meta-schemas/core.yaml#

title: Rockchip PCIe v3 phy

maintainers:
  - Heiko Stuebner <heiko@sntech.de>

properties:
  compatible:
    enum:
      - rockchip,rk3568-pcie3-phy
      - rockchip,rk3588-pcie3-phy

  reg:
    maxItems: 2

  clocks:
    minItems: 1
    maxItems: 3

  clock-names:
    contains:
      anyOf:
        - enum: [ refclk_m, refclk_n, pclk ]

  "#phy-cells":
    const: 0

  resets:
    maxItems: 1

  reset-names:
    const: phy

  rockchip,phy-grf:
    $ref: /schemas/types.yaml#/definitions/phandle
    description: phandle to the syscon managing the phy "general register files"

  rockchip,pipe-grf:
    $ref: /schemas/types.yaml#/definitions/phandle
    description: phandle to the syscon managing the pipe "general register files"

  rockchip,pcie30-phymode:
    $ref: '/schemas/types.yaml#/definitions/uint32'
    description: |
      use PHY_MODE_PCIE_AGGREGATION if not defined
    minimum: 0x0
    maximum: 0x4


required:
  - compatible
  - reg
  - rockchip,phy-grf

additionalProperties: false

unevaluatedProperties: false

examples:
  - |
    #include <dt-bindings/clock/rk3568-cru.h>
    pcie30phy: phy@fe8c0000 {
      compatible = "rockchip,rk3568-pcie3-phy";
      reg = <0x0 0xfe8c0000 0x0 0x20000>;
      #phy-cells = <0>;
      clocks = <&pmucru CLK_PCIE30PHY_REF_M>, <&pmucru CLK_PCIE30PHY_REF_N>,
       <&cru PCLK_PCIE30PHY>;
      clock-names = "refclk_m", "refclk_n", "pclk";
      resets = <&cru SRST_PCIE30PHY>;
      reset-names = "phy";
      rockchip,phy-grf = <&pcie30_phy_grf>;
    };
```

## Documentation/devicetree/bindings/soc/amlogic/clk-measure.txt
```
Amlogic Internal Clock Measurer
===============================

The Amlogic SoCs contains an IP to measure the internal clocks.
The precision is multiple of MHz, useful to debug the clock states.

Required properties:
- compatible: Shall contain "amlogic,meson-gx-clk-measure"
- reg: base address and size of the Clock Measurer register space.

Example:
	clock-measure@8758 {
		compatible = "amlogic,meson-gx-clk-measure";
		reg = <0x0 0x8758 0x0 0x10>;
	};
```

## drivers/amlogic/cpufreq/Kconfig
```kconfig
choice
	prompt "Meson CPU Freq driver"
	default AMLOGIC_SCPI_CPUFREQ

config AMLOGIC_MESON_CPUFREQ
	bool "Meson CPU Frequency scaling support"
 	select PM_OPP
	help
	This adds the CPUFreq driver for Meson series CPU
config AMLOGIC_SCPI_CPUFREQ
	bool "Meson SCPI CPU Frequency scaling support"
 	select PM_OPP
	help
	This adds the CPUFreq driver for Meson series CPU
endchoice
```

## drivers/amlogic/media_modules/Kconfig
```kconfig
#
# Amlogic Video Decoders configuration
#

menu "Video Decoders"
	depends on AMLOGIC_MEDIA_VIDEO


config AMLOGIC_MEDIA_VDEC_MPEG12
	bool "Amlogic MPEG1/2 Video Decoder"
	default y
	help
	   Driver for mpeg1/2 video decoder.
	   select AM_PTSSERVER...
	   select for build for support mpeg1 &2
		
config AMLOGIC_MEDIA_VDEC_MPEG4
	bool "Amlogic MPEG4 Video Decoder"
	default y
	help
	  Driver for mpeg4 video decoder.
		
config AMLOGIC_MEDIA_VDEC_MPEG4_MULTI
	bool "Amlogic MMPEG4 Video Decoder"
	default n
	help
	  Driver for Mmpeg4 video decoder.

config AMLOGIC_MEDIA_VDEC_VC1
	bool "Amlogic VC1 Video Decoder"
	default y
	help
	  Driver for vc1 video decoder.
		
config AMLOGIC_MEDIA_VDEC_H264
	bool "Amlogic H264 Video Decoder"
	default y
	help
	  Driver for h264 video decoder.
		
config AMLOGIC_MEDIA_VDEC_H264_MULTI
	bool "Amlogic MH264 Video Decoder"
	default n
	help
	  Driver for Mh264 video decoder.
		
config AMLOGIC_MEDIA_VDEC_H264_MVC
	bool "Amlogic H264MVC Video Decoder"
	default y
	help
	  Driver for h264mvc video decoder.
		
config AMLOGIC_MEDIA_VDEC_H265
        bool "Amlogic H265 Video Decoder"
	default y
	help
          Driver for h265 video decoder.
		
config AMLOGIC_MEDIA_VDEC_VP9
        bool "Amlogic VP9 Video Decoder"
        default y
	help
          Driver for vp9 video decoder.
		
config AMLOGIC_MEDIA_VDEC_MJPEG
	bool "Amlogic Motion JPEG Video Decoder"
	default y
	help
	  Driver for motion jpeg video decoder.
		
config AMLOGIC_MEDIA_VDEC_MJPEG_MULTI
	bool "Amlogic Motion JPEG Video Decoder"
	default y
	help
	  Driver for motion jpeg video decoder.
		
config AMLOGIC_MEDIA_VDEC_REAL
	bool "Amlogic Real Video decoder"
	default y
	help
		Enables amlogic video decoder
		
config AMLOGIC_MEDIA_VDEC_AVS
	bool "Amlogic Video AVS decoder"
	default n
	help
		Enables amlogic video decoder
		
config AMLOGIC_MEDIA_VDEC_AVS2
	bool "Amlogic Video AVS2 decoder"
	default n
	help
		Enables amlogic video decoder
		
config AMLOGIC_MEDIA_VENC_H264
	boolean "Amlogic H264Encoder support"
	default n
	help
		Internal H264 Encoder driver
		
config AMLOGIC_MEDIA_VENC_H265
	boolean "Amlogic Hevc Encoder support"
	default n
	help
		Internal Hevc Encoder driver

endmenu
```

## drivers/amlogic/media_modules/stream_input/parser/demux/sw_demux/dvbcsa2/Kconfig
```kconfig
#
# Amlogic sw demux configuration
#

menu "Meson SW DEMUX dvbcsa2 Support"

config AMLOGIC_SWDEMUX_DVBCSA
	bool "sw demux dvbcsa"
	default y
	help
		Amlogic support sw demux dvbcsa config.
		Support for sw demux dvbcsa
endmenu
```

## drivers/net/wireless/realtek/Kconfig
```kconfig
config WLAN_VENDOR_REALTEK
	bool "Realtek devices"
	default y
	---help---
	  If you have a wireless card belonging to this class, say Y.

	  Note that the answer to this question doesn't directly affect the
	  kernel: saying N will just cause the configurator to skip all
	  the questions about  cards. If you say Y, you will be asked for
	  your specific card in the following questions.

if WLAN_VENDOR_REALTEK

source "drivers/net/wireless/realtek/rtl8188eu/Kconfig"
source "drivers/net/wireless/realtek/rtl8192eu/Kconfig"
source "drivers/net/wireless/realtek/rtl8723bu/Kconfig"
source "drivers/net/wireless/realtek/rtl8811au/Kconfig"
source "drivers/net/wireless/realtek/rtl8812au/Kconfig"
source "drivers/net/wireless/realtek/rtl8812bu/Kconfig"
source "drivers/net/wireless/realtek/rtl8821cu/Kconfig"
source "drivers/net/wireless/realtek/rtl818x/Kconfig"
source "drivers/net/wireless/realtek/rtlwifi/Kconfig"
source "drivers/net/wireless/realtek/rtl8xxxu/Kconfig"

endif # WLAN_VENDOR_REALTEK
```

## drivers/net/wireless/rtl8192cu/Kconfig
```kconfig
config RTL8192CU
	tristate "Realtek 8192CU USB WiFi"
	---help---
	  Help message of RTL8192CU
```
